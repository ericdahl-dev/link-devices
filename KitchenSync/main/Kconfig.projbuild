## KitchenSync/main/Kconfig.projbuild
```kconfig
menu "KitchenSync Configuration"

    config KS_WIFI_SSID
        string "WiFi SSID"
        default ""
        help
            SSID of the WiFi network to join (same network as the Ableton Link
            session). Left empty in the repo — set it locally (menuconfig or a
            gitignored sdkconfig); do not commit credentials.

    config KS_WIFI_PASSWORD
        string "WiFi Password"
        default ""
        help
            Password for the WiFi network. Set locally; do not commit.

    config KS_TOUCH_DISPLAY
        bool "Enable the 1.47\" touch LCD (Waveshare S3-Touch-LCD-1.47)"
        depends on IDF_TARGET_ESP32S3
        default n
        help
            ESP-026 spike: drive the KitchenSync Touch 1.47" LCD + AXS5106L touch from
            this ESP-IDF firmware (see ks_display.cpp). S3-only — the panel exists on the
            Waveshare S3-Touch-LCD board; a headless S3 (Super Mini) leaves this off.
            Pulls in the LovyanGFX managed component (idf_component.yml, S3 target only).

endmenu
```

## KitchenSync/sdkconfig.defaults
```kconfig
# This P4-NANO is early silicon (chip rev v1.3). ESP-IDF v5.5 defaults its
# minimum P4 revision to v3.01 and refuses to boot; drop it to v1.0. Arduino
# tolerates v1.x natively, but the P4 hub features need ESP-IDF, so this gate is
# required here. See tasks/P4-004.md + the P4-NANO board notes.
CONFIG_ESP32P4_SELECTS_REV_LESS_V3=y
CONFIG_ESP32P4_REV_MIN_100=y

# WiFi is provided by the onboard ESP32-C6 co-processor over ESP-Hosted.
CONFIG_SLAVE_IDF_TARGET_ESP32C6=y

# Larger USB control transfers for MIDI-class config descriptors (P4-003).
CONFIG_USB_HOST_CONTROL_TRANSFER_MAX_SIZE=1024

# 1 kHz tick so the "1 ms" clock_out loop's vTaskDelay(pdMS_TO_TICKS(1)) is a real
# 1-tick yield. At the ESP-IDF default 100 Hz, pdMS_TO_TICKS(1) truncates to 0 →
# the priority-6 clock_out task busy-spins, starving IDLE0 (task-WDT) and adding
# up to 10 ms of MIDI-clock jitter. 1 kHz gives ≤1 ms clock granularity (P4-006).
CONFIG_FREERTOS_HZ=1000

# WiFi credentials (CONFIG_KS_WIFI_*) are intentionally NOT set here — set them
# locally (menuconfig or a gitignored sdkconfig); never commit credentials.

# OTA firmware updates (P4-017): a custom two-slot table (partitions.csv) so
# `POST /update` can write the inactive slot and boot into it via
# esp_ota_set_boot_partition — no factory partition, both slots are equal-purpose
# OTA targets. Custom, not the built-in two_ota table, because that one sizes its
# app slots off the flash size: at 4MB it gave 1MB slots and the app hit 96% full.
CONFIG_PARTITION_TABLE_CUSTOM=y
CONFIG_PARTITION_TABLE_CUSTOM_FILENAME="partitions.csv"

# The P4-NANO's flash chip is 16MB — CONFIRMED on hardware with `esptool.py
# flash_id` (manufacturer c8, device 4018 = GD25Q128). The old 4MB value here was
# a guess ("the minimum step that fits the two-OTA table"), and it capped the app
# slots at 1MB. partitions.csv now gives each OTA slot 4MB. This value must never
# exceed the physical chip size.
CONFIG_ESPTOOLPY_FLASHSIZE_16MB=y
```

## KitchenSync/sdkconfig.defaults.esp32s3
```kconfig
# ESP-026 spike — S3-only sdkconfig defaults.
#
# ESP-IDF auto-loads this file ON TOP OF sdkconfig.defaults when, and only when, the
# target is esp32s3 (i.e. after `idf.py set-target esp32s3`). It never affects the P4
# build. The base sdkconfig.defaults is P4-tuned; its P4-only symbols (silicon rev,
# the ESP-Hosted C6 slave, USB-host transfer size) are unknown on the S3 and are
# ignored with harmless "unknown CONFIG_*" warnings. The 16MB flash + custom OTA
# partition table it sets DO apply here and match the Waveshare S3-Touch-LCD-1.47
# board (16MB N16R8) — the same layout KitchenSyncTouch ships (partitions_devkit.csv
# is the separate 4MB DevKit table, not this board).

# Bring the 1.47" touch LCD up by default on the S3 so a fresh `set-target esp32s3`
# comes up display-enabled and only WiFi credentials need entering in menuconfig.
# Spike convenience: productization will gate the display on a per-board Kconfig, not
# on "every S3" — a headless S3 Super Mini has no panel. See ADR-0009 / ESP-026.
CONFIG_KS_TOUCH_DISPLAY=y
```

## LinkAudioPoC/main/Kconfig.projbuild
```kconfig
menu "Link Audio PoC"

config POC_WIFI_SSID
    string "WiFi SSID"
    default ""
    help
        Station SSID. Set locally (menuconfig / sdkconfig); never commit.

config POC_WIFI_PASSWORD
    string "WiFi password"
    default ""
    help
        Station password. Set locally; never commit.

endmenu
```

## LinkAudioPoC/sdkconfig.defaults
```kconfig
# P4-032 PoC — P4-NANO board gates copied from KitchenSync/sdkconfig.defaults
# (early silicon rev + C6 hosted WiFi). See that file for the full rationale.
CONFIG_ESP32P4_SELECTS_REV_LESS_V3=y
CONFIG_ESP32P4_REV_MIN_100=y
CONFIG_SLAVE_IDF_TARGET_ESP32C6=y

# asio throws; Link's esp32 example requires exceptions enabled.
CONFIG_COMPILER_CXX_EXCEPTIONS=y

# Spike: single big app slot, no OTA. The SDK + asio produce a large image;
# this is the upstream example's choice too.
CONFIG_PARTITION_TABLE_SINGLE_APP_LARGE=y
CONFIG_ESPTOOLPY_FLASHSIZE_4MB=y

# WiFi credentials (CONFIG_POC_WIFI_*) are set locally via menuconfig or a
# gitignored sdkconfig -- never committed.
```

## P4Hub/main/Kconfig.projbuild
```kconfig
menu "P4Hub Configuration"

    config P4HUB_WIFI_SSID
        string "WiFi SSID"
        default ""
        help
            SSID of the WiFi network to join (same network as the Ableton Link
            session). Left empty in the repo — set it locally (menuconfig or a
            gitignored sdkconfig); do not commit credentials.

    config P4HUB_WIFI_PASSWORD
        string "WiFi Password"
        default ""
        help
            Password for the WiFi network. Set locally; do not commit.

endmenu
```

## P4Hub/sdkconfig.defaults
```kconfig
# This P4-NANO is early silicon (chip rev v1.3). ESP-IDF v5.5 defaults its
# minimum P4 revision to v3.01 and refuses to boot; drop it to v1.0. Arduino
# tolerates v1.x natively, but the P4 hub features need ESP-IDF, so this gate is
# required here. See tasks/P4-004.md + the P4-NANO board notes.
CONFIG_ESP32P4_SELECTS_REV_LESS_V3=y
CONFIG_ESP32P4_REV_MIN_100=y

# WiFi is provided by the onboard ESP32-C6 co-processor over ESP-Hosted.
CONFIG_SLAVE_IDF_TARGET_ESP32C6=y

# Larger USB control transfers for MIDI-class config descriptors (P4-003).
CONFIG_USB_HOST_CONTROL_TRANSFER_MAX_SIZE=1024

# 1 kHz tick so the "1 ms" clock_out loop's vTaskDelay(pdMS_TO_TICKS(1)) is a real
# 1-tick yield. At the ESP-IDF default 100 Hz, pdMS_TO_TICKS(1) truncates to 0 →
# the priority-6 clock_out task busy-spins, starving IDLE0 (task-WDT) and adding
# up to 10 ms of MIDI-clock jitter. 1 kHz gives ≤1 ms clock granularity (P4-006).
CONFIG_FREERTOS_HZ=1000

# WiFi credentials (CONFIG_P4HUB_WIFI_*) are intentionally NOT set here — set them
# locally (menuconfig or a gitignored sdkconfig); never commit credentials.

# OTA firmware updates (P4-016): the built-in two-slot table (otadata + ota_0 +
# ota_1, ~1.5 MB each) so `POST /update` can write the inactive slot and boot
# into it via esp_ota_set_boot_partition — no factory partition, both slots are
# equal-purpose OTA targets.
CONFIG_PARTITION_TABLE_TWO_OTA=y
```
